## west.yml
```yaml
manifest:
  self:
    path: greybus
  remotes:
    - name: zephyrproject-rtos
      url-base: https://github.com/zephyrproject-rtos
  projects:
    - name: zephyr
      remote: zephyrproject-rtos
      revision: v2.7.0
      import: true
```
