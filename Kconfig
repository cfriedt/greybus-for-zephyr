## dts/bindings/greybus/zephyr,greybus-bundle.yaml
```yaml
# Copyright (c) 2020, Friedt Professional Engineering Services, Inc
# SPDX-License-Identifier: Apache-2.0

# Common fields for Greybus Bundles

description: Greybus Bundle

compatible: "zephyr,greybus-bundle"

include: [base.yaml]

properties:
    "greybus-bundle":
      type: boolean
      required: true
      description: Conveys this node is an instance of a Greybus Bundle
    "id":
      type: int
      required: true
      description: Bundle ID
    "bundle-class":
      type: int
      required: true
      description: The Greybus BundleClass (see dt-bindings/greybus/greybus.h)
```

## dts/bindings/greybus/zephyr,greybus-control.yaml
```yaml
# Copyright (c) 2020, Friedt Professional Engineering Services, Inc
# SPDX-License-Identifier: Apache-2.0

# Common fields for Greybus Controllers

description: Greybus Control

compatible: "zephyr,greybus-control"

include: ["zephyr,greybus-cport.yaml"]

properties:
    "greybus-controller":
      type: boolean
      required: true
      description: Conveys this node is an instance of a Greybus Controller
    "cport-protocol":
      type: int
      # Control protocol
      default: 0x00
      const: 0x00
      description: The Control CPort protocol
```

## dts/bindings/greybus/zephyr,greybus-cport.yaml
```yaml
# Copyright (c) 2020, Friedt Professional Engineering Services, Inc
# SPDX-License-Identifier: Apache-2.0

# Common fields for Greybus Controllers

description: Greybus CPort Descriptor

# should not be directly instantiated
# compatible: "zephyr,greybus-cport"

include: [base.yaml]

properties:
    "id":
      type: int
      required: true
      description: Bundle ID
    "cport-protocol":
      type: int
      required: true
      description: Conveys the CPortProtocol that is used on this CPort  
```

## dts/bindings/greybus/zephyr,greybus-gpio-control.yaml
```yaml
# Copyright (c) 2020, Friedt Professional Engineering Services, Inc
# SPDX-License-Identifier: Apache-2.0

# Common fields for Greybus GPIO Controllers

description: Greybus GPIO Controller

compatible: "zephyr,greybus-gpio-controller"

include: ["zephyr,greybus-cport.yaml"]

properties:
    "greybus-gpio-controller":
      type: phandle
      required: true
      description: Conveys which GPIO port is associated with this Greybus GPIO Controller instance
    "cport-protocol":
      type: int
      # GPIO protocol
      default: 0x02
      const: 0x02
      description: The GPIO CPort protocol
```

## dts/bindings/greybus/zephyr,greybus-i2c-control.yaml
```yaml
# Copyright (c) 2020, Friedt Professional Engineering Services, Inc
# SPDX-License-Identifier: Apache-2.0

# Common fields for Greybus I2C Controllers

description: Greybus I2C Controller

compatible: "zephyr,greybus-i2c-controller"

include: ["zephyr,greybus-cport.yaml"]

properties:
    "greybus-i2c-controller":
      type: phandle
      required: true
      description: Conveys which I2C port is associated with this Greybus I2C Controller instance
    "cport-protocol":
      type: int
      # I2C protocol
      default: 0x03
      const: 0x03
      description: The I2C CPort protocol
```

## dts/bindings/greybus/zephyr,greybus-interface.yaml
```yaml
# Copyright (c) 2020, Friedt Professional Engineering Services, Inc
# SPDX-License-Identifier: Apache-2.0

# Common fields for GPIO controllers

description: Greybus Interface

compatible: "zephyr,greybus-interface"

include: [base.yaml]

properties:
    "greybus-interface":
      type: boolean
      required: true
      description: DeviceTree representation of a Greybus manifest string descriptor
    "vendor-string-id":
      type: phandle
      required: true
      description: "Reference to greybus-string describing the vendor"
    "product-string-id":
      type: phandle
      required: true
      description: "Reference to greybus-string describing the product"
```

## dts/bindings/greybus/zephyr,greybus-spi-control.yaml
```yaml
# Copyright (c) 2020, Friedt Professional Engineering Services, Inc
# SPDX-License-Identifier: Apache-2.0

# Common fields for Greybus SPI Controllers

description: Greybus SPI Controller

compatible: "zephyr,greybus-spi-controller"

# Common fields for Greybus SPI Controllers
# used to build a "struct gb_spi_master_config_response".
# Children of this node are used to build a table of
# "struct gb_spi_device_config_response".

include: ["zephyr,greybus-cport.yaml"]

properties:
    "greybus-spi-controller":
      type: phandle
      required: true
      description: Conveys which SPI port is associated with this Greybus SPI Controller instance
    "cport-protocol":
      type: int
      # SPI protocol
      default: 0x0b
      const: 0x0b
      description: The SPI CPort protocol
    "bpw-mask":
      type: int
      required: true
      description: The number of bits per SPI word transferred
    "min-speed-hz":
      type: int
      required: true
      description: The minimum bus speed supported by the SPI controller
    "max-speed-hz":
      type: int
      required: true
      description: The maximum bus speed supported by the SPI controller
    "mode":
      # see GB_SPI_MODE_* defined in dt-bindings/greybus/spi.h
      type: int
      required: true
      description: Greybus SPI mode bits
    "flags":
      # see GB_SPI_FLAG_* defined in dt-bindings/greybus/spi.h
      type: int
      required: true
      description: Greybus SPI flag bits
```

## dts/bindings/greybus/zephyr,greybus-spi-peripheral.yaml
```yaml
# Copyright (c) 2020, Friedt Professional Engineering Services, Inc
# SPDX-License-Identifier: Apache-2.0

# Common fields for Greybus SPI Peripherals
# used to build a table of "struct gb_spi_device_config_response".
# See also "zephyr,greybus-spi-controller"

description: Greybus SPI Peripheral

compatible: "zephyr,greybus-spi-peripheral"

include: ["base.yaml"]

properties:
    "cs":
      type: int
      required: true
    "mode":
      type: int
      required: true
      description: The chip-select associated with this SPI peripheral
    "bpw":
      type: int
      required: true
      description: The number of bits per SPI word that this peripheral accepts
    "max-speed-hz":
      type: int
      required: true
      description: The maximum bus speed supported by this SPI peripheral
    "device-type":
      # see GB_SPI_SPI_* defined in dt-bindings/greybus/spi.h
      type: int
      required: true
      description: Greybus SPI device type
    "device-name":
      type: string
      required: true
      description: Greybus SPI device name
```

## dts/bindings/greybus/zephyr,greybus-string.yaml
```yaml
# Copyright (c) 2020, Friedt Professional Engineering Services, Inc
# SPDX-License-Identifier: Apache-2.0

description: Greybus Manifest String Descriptor

compatible: "zephyr,greybus-string"

include: [base.yaml]

properties:
    "id":
      type: int
      required: true
      description: Bar
    "greybus-string":
      type: string
      required: true
      description: Foo
```

## dts/bindings/greybus/zephyr,greybus.yaml
```yaml
# Copyright (c) 2020, Friedt Professional Engineering Services, Inc
# SPDX-License-Identifier: Apache-2.0

# Common fields for GPIO controllers

description: Greybus

compatible: "zephyr,greybus"

include: [base.yaml]

properties:
    "greybus":
      type: boolean
      required: true
      description: Foo
    "version-major":
      type: int
      required: true
      # GREYBUS_VERSION_MAJOR
      default: 0
      description: Greybus Protocol Major Version 
    "version-minor":
      type: int
      required: true
      # GREYBUS_VERSION_MINOR
      default: 1
      description: Greybus Protocol Minor Version 
    "#address-cells":
      type: int
      required: false
      default: 1
      const: 1
    "#size-cells":
      type: int
      required: false
      default: 0
      const: 0
```

## subsys/greybus/Kconfig
```kconfig
# Kconfig - Greybus configuration options
#
# Copyright (c) 2019 Christopher Friedt, <chrisfriedt@gmail.com>
#
# SPDX-License-Identifier: BSD-3-Clause

menuconfig GREYBUS
	bool "Greybus"
	depends on PTHREAD_DYNAMIC_STACK
	depends on PTHREAD_IPC
	help
	  This option enables Greybus support.

if GREYBUS

choice
	prompt "Greybus Manifest Source"
	default GREYBUS_MANIFEST_BUILTIN

config GREYBUS_MANIFEST_BUILTIN
	bool "Compile the manifest into the application"
	help
	  Choosing this option generates a Greybus Manifest
	  Source file from the unfixed DeviceTree header,
	  converts that into a Greybus Manifest Binary file,
	  and then generates an array in C from the binary
	  data.
endchoice

config GREYBUS_ENABLE_TLS
	bool "Use Transport Layer Security (TLS)"
	depends on TLS_CREDENTIALS
	help
	  Choose this option to use industry standard
	  TLS 1.2 authentication and encryption with
	  Greybus.

if GREYBUS_ENABLE_TLS

config GREYBUS_TLS_HOSTNAME
	string "The hostname to use for TLS connections"
	default "localhost"
	help
	  This is the hostname that is presented to TLS clients
	  as specified in the TLS certificate. Currently there
	  is not a convenient programmatic way to extract this
	  information from the TLS certificate at runtime, and
	  so it must be manually specified.

	  This has nothing to do with the values of
	  CONFIG_NET_HOSTNAME or CONFIG_NET_HOSTNAME_ENABLE.

choice
	prompt "How shall the Greybus server verify clients?"
	default GREYBUS_TLS_CLIENT_VERIFY_REQUIRED

config GREYBUS_TLS_CLIENT_VERIFY_NONE
	bool "No Client Verification"
	help
	  Choose this option so that Greybus never attmpts to verify
	  client credentials. This option is insecure.

	  If unsure, say N here.

config GREYBUS_TLS_CLIENT_VERIFY_OPTIONAL
	bool "Optional Client Verification"
	help
	  Choose this option so that Greybus only attmpts to verify
	  client credentials if they provide them. This option is
	  insecure.

	  If unsure, say N here.

config GREYBUS_TLS_CLIENT_VERIFY_REQUIRED
	bool "Required Client Verification"
	help
	  Choose this option so that Greybus requires clients to present
	  verifiable credentials. This is the only secure option.

	  If unsure, say Y here.
endchoice

choice
	prompt "How will TLS credentials be supplied?"
	default GREYBUS_TLS_BUILTIN

config GREYBUS_TLS_BUILTIN
	bool "Compile certificates into the application"
	help
	  This option compiles all certificates into the application
	  by converting the specified files into C arrays.
	  
	  Note, security may be compromised if an attacker has
	  physical access to the device. As such this option is insecure.
endchoice

if GREYBUS_TLS_BUILTIN
config GREYBUS_TLS_BUILTIN_CA_CERT
	string "Path to the CA certificate (for client verification)"
	depends on GREYBUS_TLS_CLIENT_VERIFY_OPTIONAL || GREYBUS_TLS_CLIENT_VERIFY_REQUIRED
	default "${ZEPHYR_BASE}/samples/net/sockets/echo_server/src/ca.der"
	help
	  The path to the Certificate Signing-Authority certificate

config GREYBUS_TLS_BUILTIN_SERVER_CERT
	string "Path to the Greybus server certificate"
	default "${ZEPHYR_BASE}/samples/net/sockets/echo_server/src/server.der"
	help
	  The path to the Greybus Server certificate (public key)

config GREYBUS_TLS_BUILTIN_SERVER_PRIVKEY
	string "Path to the Greybus server private key"
	default "${ZEPHYR_BASE}/samples/net/sockets/echo_server/src/server_privkey.der"
	help
	  The path to the Greybus Server private key

endif # GREYBUS_TLS_BUILTIN
endif # GREYBUS_ENABLE_TLS

choice
	prompt "Which transport shall be used for Greybus?"
	default GREYBUS_XPORT_TCPIP

config GREYBUS_XPORT_TCPIP
	bool "Use the TCP/IP Transport for Greybus"
	depends on NET_TCP
	depends on NET_SOCKETS
	depends on NET_SOCKETS_POSIX_NAMES
	depends on !GREYBUS_ENABLE_TLS || (GREYBUS_ENABLE_TLS && NET_SOCKETS_SOCKOPT_TLS)
	help
	  This creates a TCP/IP service for Greybus.

config GREYBUS_XPORT_UART
	bool "Use the UART Transport for Greybus"
	depends on SERIAL
	depends on SERIAL_HAS_DRIVER
	help
	  This creates a thread for Greybus on a specific UART.

if GREYBUS_XPORT_UART
config GREYBUS_XPORT_UART_DEV
	string "Run Greybus on which UART?"
	default "UART_1"
	help
	  This setting specifies which UART the Greybus service will use.
endif # GREYBUS_XPORT_UART
endchoice

config GREYBUS_AUDIO
	bool "Greybus Audio"
	help
	  Select this for Greybus Audio support.

config GREYBUS_CAMERA
	bool "Greybus Camera"
	help
	  Select this for Greybus Camera support.

config GREYBUS_CONTROL
	bool "Greybus Control"
	help
	  Select this for a Greybus Control cport.

config GREYBUS_GPIO
	bool "Greybus GPIO"
	help
	  Select this for Greybus GPIO support.

config GREYBUS_HID
	bool "Greybus HID"
	help
	  Select this for Greybus HID support.

config GREYBUS_I2C
	bool "Greybus I2C"
	help
	  Select this for Greybus I2C support.

config GREYBUS_LIGHTS
	bool "Greybus Lights"
	help
	  Select this for Greybus Light support.

config GREYBUS_LOOPBACK
	bool "Greybus Loopback"
	help
	  Select this for Greybus Loopback support.

config GREYBUS_POWER_SUPPLY
	bool "Greybus Power Supply"
	help
	  Select this for Greybus Power Supply support.

config GREYBUS_PWM
	bool "Greybus PWM"
	help
	  Select this for Greybus Pulse Width Modulation support.

config GREYBUS_SDIO
	bool "Greybus SDIO"
	help
	  Select this for Greybus Secure Digital IO support.

config GREYBUS_SPI
	bool "Greybus SPI"
	help
	  Select this for Greybus Serial Peripheral Interface support.

config GREYBUS_UART
	bool "Greybus UART"
	help
	  Select this for Greybus Universal Asynchronous Receiver Transmitter support.

config GREYBUS_USB
	bool "Greybus USB"
	help
	  Select this for Greybus Universal Serial Bus support.

config GREYBUS_VIBRATOR
	bool "Greybus Vibrator"
	help
	  Select this for Greybus Vibrator support.

config GREYBUS_SERVICE_INIT_PRIORITY
	int "default Greybus Service Init Priority"
	default 85
	range 0 99
	help
	  Greybus service init priority to ensure device initialization order.

config GREYBUS_STRING_INIT_PRIORITY
	int "default Greybus String Init Priority"
	default 86
	range 0 99
	help
	  Greybus string init priority to ensure device initialization order.

config GREYBUS_INTERFACE_INIT_PRIORITY
	int "default Greybus Interface Init Priority"
	default 87
	range 0 99
	help
	  Greybus interface init priority to ensure device initialization order.

config GREYBUS_BUNDLE_INIT_PRIORITY
	int "default Greybus Bundle Init Priority"
	default 88
	range 0 99
	help
	  Greybus bundle init priority to ensure device initialization order.

config GREYBUS_CPORT_INIT_PRIORITY
	int "default Greybus Cport Init Priority"
	default 89
	range 0 99
	help
	  Greybus cport init priority to ensure device initialization order.

module = GREYBUS
module-str = Greybus
source "subsys/logging/Kconfig.template.log_config"

endif # GREYBUS
```

## tests/subsys/greybus/gpio/testcase.yaml
```yaml
tests:
  subsys.greybus.gpio:
    tags: greybus
    harness: ztest
    platform_allow: mps2_an385 qemu_cortex_m3
  subsys.greybus.gpio.tls:
    tags: greybus tls
    harness: ztest
    # build_only for now due to issues in Zephyr mbedTLS / IPPROTO_TLS_1_2
    # for details see cfriedt/greybus-for-zephyr#34
    build_only: True
    platform_allow: mps2_an385 qemu_x86_64
    extra_configs:
      - CONFIG_GREYBUS_ENABLE_TLS=y
      - CONFIG_GREYBUS_TLS_BUILTIN=y
      - CONFIG_NET_SOCKETS_SOCKOPT_TLS=y
      - CONFIG_TLS_CREDENTIALS=y
      - CONFIG_NET_PKT_RX_COUNT=64
      - CONFIG_NET_PKT_TX_COUNT=64
      - CONFIG_NET_BUF_RX_COUNT=64
      - CONFIG_NET_BUF_TX_COUNT=64
      - CONFIG_TLS_MAX_CREDENTIALS_NUMBER=5
      - CONFIG_NET_SOCKETS_TLS_MAX_CONTEXTS=10
      - CONFIG_ZTEST_STACKSIZE=8192
      - CONFIG_HEAP_MEM_POOL_SIZE=32768
      - CONFIG_PTHREAD_DYNAMIC_STACK_DEFAULT_SIZE=8192
```

## tests/subsys/greybus/i2c/testcase.yaml
```yaml
tests:
  subsys.greybus:
    tags: greybus
    depends_on: greybus gpio
    min_flash: 34
    filter: dt_compat_enabled("test,greybus")
    harness: ztest
    harness_config:
      fixture: gpio_loopback
```
